## boards/arm/akdk_bt1/Kconfig
```kconfig
config BOARD_ENABLE_DCDC
    bool "Enable DCDC mode"
    select SOC_DCDC_NRF52X
    default y
    depends on BOARD_AKDK_BT1

config ZMK_BEHAVIOR
    bool "Enable ZMK behaviors"
    default y
    depends on BOARD_AKDK_BT1
```

## boards/shields/tstk_tl6tn9/Kconfig.defconfig
```kconfig
if SHIELD_TSTK_TL6TN9_RIGHT

config ZMK_KEYBOARD_NAME
    default "tstk_tl6tn9"

config ZMK_POINTING
    default y

config PAW3222
    default y

config PAW3222_BEHAVIOR
    default y

endif

if SHIELD_TSTK_TL6TN9_LEFT || SHIELD_TSTK_TL6TN9_RIGHT

config ZMK_SPLIT
    default y

endif

if SHIELD_TSTK_TL6TN9_LEFT || SHIELD_TSTK_TL6TN9_RIGHT

config ZMK_BLE
    default y

config BT
    default y

config BT_PERIPHERAL
    default y

config BT_CENTRAL
    default y

config BT_SMP
    default y

config BT_FIXED_PASSKEY
    default n

endif
```

## boards/shields/tstk_tl6tn9/Kconfig.shield
```kconfig
config SHIELD_TSTK_TL6TN9_LEFT
    def_bool $(shields_list_contains,tstk_tl6tn9_left)
config SHIELD_TSTK_TL6TN9_RIGHT
    def_bool $(shields_list_contains,tstk_tl6tn9_right)
```

## config/west.yml
```yaml
manifest:
  remotes:
    - name: zmkfirmware
      url-base: https://github.com/zmkfirmware
    - name: tyama1531-lab
      url-base: https://github.com/tyama1531-lab

  projects:
    - name: zmk
      remote: zmkfirmware
      revision: v0.3.0
      import: app/west.yml

    - name: zmk-driver-paw3222-alpha3
      remote: tyama1531-lab
      revision: main

  self:
    path: config
```
